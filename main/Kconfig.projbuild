## main/Kconfig.projbuild
```kconfig
menu "I2C Example Configuration"

    orsource "$IDF_PATH/examples/common_components/env_caps/$IDF_TARGET/Kconfig.env_caps"

    config I2C_MASTER_SCL
        int "SCL GPIO Num"
        range ENV_GPIO_RANGE_MIN ENV_GPIO_OUT_RANGE_MAX
        default 4
        help
            GPIO number for I2C Master clock line.

    config I2C_MASTER_SDA
        int "SDA GPIO Num"
        range ENV_GPIO_RANGE_MIN ENV_GPIO_OUT_RANGE_MAX
        default 5
        help
            GPIO number for I2C Master data line.

    config I2C_MASTER_FREQUENCY
        int "Master Frequency"
        default 400000
        help
            I2C Speed of Master device.

endmenu

menu "GPIO Example Configuration"

    orsource "$IDF_PATH/examples/common_components/env_caps/$IDF_TARGET/Kconfig.env_caps"

    config GPIO_OUTPUT_SI4713_RST
        int "GPIO output pin RST"
        range ENV_GPIO_RANGE_MIN ENV_GPIO_OUT_RANGE_MAX
        default 3
        help
            GPIO pin number to be used as output connected to Si4713 RST pin.

    config GPIO_INPUT_ENCODER_SIA
        int "GPIO input pin SIA"
        range ENV_GPIO_RANGE_MIN ENV_GPIO_OUT_RANGE_MAX
        default 15
        help
            GPIO pin number to be used as input connected to encoder SIA pin.

    config GPIO_INPUT_ENCODER_SIB
        int "GPIO input pin SIB"
        range ENV_GPIO_RANGE_MIN ENV_GPIO_OUT_RANGE_MAX
        default 18
        help
            GPIO pin number to be used as input connected to encoder SIB pin.

    config GPIO_INPUT_ENCODER_SW
        int "GPIO input pin SW"
        range ENV_GPIO_RANGE_MIN ENV_GPIO_OUT_RANGE_MAX
        default 23
        help
            GPIO pin number to be used as input connected to encoder SW pin.
endmenu

menu "A2DP Example Configuration"
    config EXAMPLE_A2DP_SINK_SSP_ENABLED
        bool "Secure Simple Pairing"
        depends on BT_CLASSIC_ENABLED
        default y
        help
            This enables the Secure Simple Pairing. If disable this option,
            Bluedroid will only support Legacy Pairing

    choice EXAMPLE_A2DP_SINK_OUTPUT
        prompt "A2DP Sink Output"
        default EXAMPLE_A2DP_SINK_OUTPUT_EXTERNAL_I2S
        help
            Select to use Internal DAC or external I2S driver

        config EXAMPLE_A2DP_SINK_OUTPUT_INTERNAL_DAC
            bool "Internal DAC"
            help
                Select this to use Internal DAC sink output,
                note that DAC_DMA_AUTO_16BIT_ALIGN should be turned off
                because the audio data are already 16-bit width

        config EXAMPLE_A2DP_SINK_OUTPUT_EXTERNAL_I2S
            bool "External I2S Codec"
            help
                Select this to use External I2S sink output

    endchoice

    config EXAMPLE_I2S_LRCK_PIN
        int "I2S LRCK (WS) GPIO"
        default 22
        depends on EXAMPLE_A2DP_SINK_OUTPUT_EXTERNAL_I2S
        help
            GPIO number to use for I2S LRCK(WS) Driver.

    config EXAMPLE_I2S_BCK_PIN
        int "I2S BCK GPIO"
        default 26
        depends on EXAMPLE_A2DP_SINK_OUTPUT_EXTERNAL_I2S
        help
            GPIO number to use for I2S BCK Driver.

    config EXAMPLE_I2S_DATA_PIN
        int "I2S DATA GPIO"
        default 25
        depends on EXAMPLE_A2DP_SINK_OUTPUT_EXTERNAL_I2S
        help
            GPIO number to use for I2S Data Driver.

    config EXAMPLE_LOCAL_DEVICE_NAME
        string "Local Device Name"
        default "ESP_SPEAKER"
        help
            Use this option to set local device name.

    config EXAMPLE_AVRCP_CT_COVER_ART_ENABLE
        bool "Use AVRCP CT Cover Art Feature"
        depends on BT_CLASSIC_ENABLED
        default y
        help
            This enables the AVRCP Cover Art feature in example and try to get cover art image from peer device.

    config EXAMPLE_A2DP_SINK_USE_EXTERNAL_CODEC
        bool "Use External Codec Instead of Internal"
        default n
        select BT_A2DP_USE_EXTERNAL_CODEC
        help
            If enable, Bluedroid stack will not decode A2DP audio data, user need to decode it in application layer.

endmenu
```
